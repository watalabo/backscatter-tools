// These arguments were used when this file was generated. They will be automatically applied on subsequent loads 
// via the GUI or CLI invocations. Run CLI with '--help' for additional information on how to override these arguments.
// @cliArgs --board "/ti/boards/CC1352P1_LAUNCHXL" --product "simplelink_cc13x2_26x2_sdk@3.20.00.68"
// @versions {"data":"2019051709","timestamp":"2019051709","tool":"1.1.792","templates":"2019051709"}

var RF = scripting.addModule("/ti/drivers/RF");
var GPIO = scripting.addModule("/ti/drivers/GPIO");
var GPIO1 = GPIO.addInstance();
var GPIO2 = GPIO.addInstance();
var UART = scripting.addModule("/ti/drivers/UART");
var UART1 = UART.addInstance();
var ti154stack = scripting.addModule("/ti/ti154stack/ti154stack");
var NVS = scripting.addModule("/ti/drivers/NVS");
var NVS1 = NVS.addInstance();
// Use Hardware - Select the hardware to use, or 'none' to use available header pins
RF.$hardware = system.deviceData.board.components.RF;
var Power = scripting.addModule("/ti/drivers/Power");
var Board = scripting.addModule("/ti/drivers/Board");
// Name - The C/C++ identifier used in applications as the index parameter passed to GPIO runtime APIs
GPIO1.$name = "Board_GPIO0";
// Use Hardware - Select the hardware to use, or 'none' to use available header pins
GPIO1.$hardware = system.deviceData.board.components.LED_RED;
// Initial Output State
GPIO1.initialOutputState = "High";
// Assign pin
GPIO1.gpioPin.$assign = "boosterpack.39"; // DIO6
// Name
GPIO1.pinInstance.$name = "Board_PIN0";
// Name - The C/C++ identifier used in applications as the index parameter passed to GPIO runtime APIs
GPIO2.$name = "Board_GPIO1";
// Use Hardware - Select the hardware to use, or 'none' to use available header pins
GPIO2.$hardware = system.deviceData.board.components.LED_GREEN;
// Initial Output State
GPIO2.initialOutputState = "High";
// Assign pin
GPIO2.gpioPin.$assign = "boosterpack.40"; // DIO7
// Name
GPIO2.pinInstance.$name = "Board_PIN1";
// Name - The C/C++ identifier used in applications as the index parameter passed to UART runtime APIs
UART1.$name = "Board_UART0";
// Use Hardware - Select the hardware to use, or 'none' to use available header pins
UART1.$hardware = system.deviceData.board.components.xds110Uart;
// Name
UART1.txPinInstance.$name = "Board_PIN2";
// Name
UART1.rxPinInstance.$name = "Board_PIN3";
// Name
UART1.uart.$name = "MyUART1";
// Frequency Band - Configures the frequency band used for radio operations
ti154stack.frequencyBand = "2.4 GHz";
// Project - Configures project type for device configuration
ti154stack.project = "sensor";
var multi_stack_validate = scripting.addModule("/ti/easylink/multi_stack_validate");
// Name - The C/C++ identifier used in applications as the index parameter passed to NVS runtime APIs
NVS1.$name = "Board_NVS0";
// Use Hardware - Select the hardware to use, or 'none' to use available header pins
NVS1.$hardware = system.deviceData.board.components.SPIFlash;
// Name
NVS1.externalFlash.$name = "ti_drivers_nvs_NVSSPI25X0";
var NVSSPI25XDevice1 = NVS1.externalFlash.spiFlashDevice; // Create reference
// Name
NVSSPI25XDevice1.$name = "Board_NVS_SPI0";
// Name - The C/C++ identifier used in applications as the index parameter passed to GPIO runtime APIs
NVSSPI25XDevice1.slaveSelectGpioInstance.$name = "Board_GPIO2";
// Mode - Select the GPIO mode
NVSSPI25XDevice1.slaveSelectGpioInstance.mode = "Output";
// Name
NVSSPI25XDevice1.slaveSelectGpioInstance.pinInstance.$name = "Board_PIN4";
var SPI1 = NVSSPI25XDevice1.sharedSpiInstance; // Create reference
// Name - The C/C++ identifier used in applications as the index parameter passed to SPI runtime APIs
SPI1.$name = "Board_SPI0";
// Name
SPI1.sclkPinInstance.$name = "Board_PIN5";
// Name
SPI1.misoPinInstance.$name = "Board_PIN6";
// Name
SPI1.mosiPinInstance.$name = "Board_PIN7";
var DMA = scripting.addModule("/ti/drivers/DMA");
// Name
SPI1.spi.$name = "MySSI1";
// Suggest solution
RF.rfAntennaPin0.$suggestSolution = "43";
// Suggest solution
RF.rfAntennaPin1.$suggestSolution = "42";
// Suggest solution
RF.rfAntennaPin2.$suggestSolution = "41";
// Suggest solution
UART1.uart.$suggestSolution = "UART0";
// Suggest solution
UART1.uart.txPin.$suggestSolution = "19";
// Suggest solution
UART1.uart.rxPin.$suggestSolution = "18";
// Suggest solution
NVSSPI25XDevice1.slaveSelectGpioInstance.gpioPin.$suggestSolution = "30";
// Suggest solution
SPI1.spi.$suggestSolution = "SSI0";
// Suggest solution
SPI1.spi.sclkPin.$suggestSolution = "16";
// Suggest solution
SPI1.spi.misoPin.$suggestSolution = "14";
// Suggest solution
SPI1.spi.mosiPin.$suggestSolution = "15";
